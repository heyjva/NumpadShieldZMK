## boards/shields/numpad/Kconfig.defconfig
```kconfig
if SHIELD_NUMPAD

config ZMK_KEYBOARD_NAME
    default "Numpad"

config ZMK_MOUSE
    default y

config I2C
    default y

endif
```

## boards/shields/numpad/Kconfig.shield
```kconfig
config SHIELD_NUMPAD
    def_bool $(shields_list_contains,numpad)

config SHIELD_PIMTRACKBALL
    def_bool $(shields_list_contains,pimtrackball)
```

## config/boards/shields/numpad/Kconfig.defconfig
```kconfig
if SHIELD_NUMPAD

config ZMK_KEYBOARD_NAME
    default "Numpad"

config ZMK_MOUSE
    default y

config I2C
    default y

config INPUT
    default y

config INPUT_PINNACLE
    default y

endif
```
